ENTRY(EfiMain)

/**
 * This is a GNU linker script designed for conversion of an ELF-format executable (generated by
 * the companion sript, link-elf.ldf) into an EFI executable (PE format).
 *
 * Essentially, we just replicate each section in the same order that it was produced in the ELF.
 * That gives us "debug compatibility" - i.e. the debug symbols in the ELF should match the
 * addresses in the PE file. 
 */

SECTIONS {

    .text 0x1000 : {
        *(.text)
    }

    . = ALIGN(0x1000);

    .rodata : {
        *(.rodata)
    }

    . = ALIGN(8);

    .eh_frame : {
        KEEP(*(.eh_frame))
    }
    
    .eh_frame_hdr : {
        KEEP(*(.eh_frame_hdr))
    }

    . = ALIGN(0x1000);

    .data : {
        *(.data)
    }

    .bss . : {
        *(.bss)
    }

    /* Relocations at the end. We could also put them before .bss, but doing this instead
     * theoretically gives the option of disposing of relocations after load (without leaving a
     * hole). We must put .reloc after .text/.data/.rodata since it must come after sections it
     * contains relocations for, apparently. */

    . = ALIGN(0x1000);

    .reloc . : {
        *(.reloc)
    }

    /* sections to discard */

    /DISCARD/ : {
        *(.comment)
        *(.note.gnu.property)
        *(.note.GNU-stack)
        *(.dynamic)
    }
}
